#include "main.h"
#include "lcd.h"



#if ASIX_MINI 
#include  <intrins.h> 
#endif

#if ARM_MINI
#define _nop_() 
#endif


#include <string.h>
#include <ctype.h>   

#if (ARM_MINI || ASIX_MINI)

U8_T const code aby_Char_Table[10] = {'0','1','2','3','4','5','6','7','8','9'};

/*(0) !(1) "(2) #(3) $(4) %(5) &(6) '(7) ((8) )(9) *(10) +(11) ,(12) -(13) .(14) /(15)
 0(16) 1(17) 2(18) 3(19) 4(20) 5(21) 6(22) 7(23) 8(24) 9(25) :(26) ;(27) <(28) =(29) >(30) ?(31)
 @(32) A(33) B(34) C(35) D(36) E(37) F(38) G(39) H(40) I(41) J(42) K(43) L(44) M(45) N(46) O(47)
 P(48) Q(49) R(50) S(51) T(52) U(53) V(54) W(55) X(56) Y(57) Z(58) [(59) \(60) ](61) ^(62) _(63)
 `(64) a(65) b(66) c(67) d(68) e(69) f(70) g(71) h(72) i(73) j(74) k(75) l(76) m(77) n(78) o(79)
 p(80) q(81) r(82) s(83) t(84) u(85) v(86) w(87) x(88) y(89) z(90) {(91) |(92) }(93) ~(94) |(95)*/ 




U8_T const code Dot8_16[95][2][8] = 
{
	{
		{0xFF,0xFF,0xFF,0xFF,0xFF,0xFF,0xFF,0xFF},
		{0xFF,0xFF,0xFF,0xFF,0xFF,0xFF,0xFF,0xFF},/*" ",0*/
	},
	{
		{0xFF,0xFF,0xFF,0x03,0xFF,0xFF,0xFF,0xFF},
		{0xFF,0xFF,0xFF,0xF3,0xFF,0xFF,0xFF,0xFF},/*"!",1*/
	},
	{
		{0xFF,0xEF,0xF3,0xEF,0xF3,0xFF,0xFF,0xFF},
		{0xFF,0xFF,0xFF,0xFF,0xFF,0xFF,0xFF,0xFF},/*""",2*/
	},
	{
		{0xFF,0xEF,0x03,0xEF,0x03,0xEF,0xFF,0xFF},
		{0xFF,0xFB,0xE0,0xFB,0xE0,0xFB,0xFF,0xFF},/*"#",3*/
	},
	{
		{0xFF,0xCF,0xB7,0x03,0x77,0xCF,0xFF,0xFF},
		{0xFF,0xF9,0xF7,0xE0,0xF7,0xF8,0xFF,0xFF},/*"$",4*/
	},
	{
		{0xFF,0xE7,0xDB,0x27,0xCF,0xF3,0xFF,0xFF},
		{0xFF,0xF3,0xFC,0xF9,0xF6,0xF9,0xFF,0xFF},/*"%",5*/
	},
	{
		{0xFF,0x67,0x9B,0x67,0xFF,0x7F,0xFF,0xFF},
		{0xFF,0xF8,0xF7,0xF6,0xF9,0xF6,0xFF,0xFF},/*"&",6*/
	},
	{
		{0xFF,0xFF,0xEB,0xF3,0xFF,0xFF,0xFF,0xFF},
		{0xFF,0xFF,0xFF,0xFF,0xFF,0xFF,0xFF,0xFF},/*"'",7*/
	},
	{
		{0xFF,0xFF,0x1F,0xE7,0xFB,0xFF,0xFF,0xFF},
		{0xFF,0xFF,0xFC,0xF3,0xEF,0xFF,0xFF,0xFF},/*"(",8*/
	},
	{
		{0xFF,0xFF,0xFB,0xE7,0x1F,0xFF,0xFF,0xFF},
		{0xFF,0xFF,0xEF,0xF3,0xFC,0xFF,0xFF,0xFF},/*")",9*/
	},
	{
		{0xFF,0x9F,0x7F,0x0F,0x7F,0x9F,0xFF,0xFF},
		{0xFF,0xFC,0xFF,0xF8,0xFF,0xFC,0xFF,0xFF},/*"*",10*/
	},
	{
		{0xFF,0x7F,0x7F,0x0F,0x7F,0x7F,0xFF,0xFF},
		{0xFF,0xFF,0xFF,0xF8,0xFF,0xFF,0xFF,0xFF},/*"+",11*/
	},
	{
		{0xFF,0xFF,0xFF,0xFF,0xFF,0xFF,0xFF,0xFF},
		{0xFF,0xFF,0xEB,0xF3,0xFF,0xFF,0xFF,0xFF},/*",",12*/
	},
	{
		{0xFF,0x7F,0x7F,0x7F,0x7F,0xFF,0xFF,0xFF},
		{0xFF,0xFF,0xFF,0xFF,0xFF,0xFF,0xFF,0xFF},/*"-",13*/
	},
	{
		{0xFF,0xFF,0xFF,0xFF,0xFF,0xFF,0xFF,0xFF},
		{0xFF,0xFF,0xF3,0xF3,0xFF,0xFF,0xFF,0xFF},/*".",14*/
	},
	{
		{0xFF,0xFF,0xFF,0x3F,0xCF,0xF3,0xFF,0xFF},
		{0xFF,0xE7,0xF9,0xFE,0xFF,0xFF,0xFF,0xFF},/*"/",15*/
	},
	{
		{0xFF,0x0F,0xF7,0xF7,0x0F,0xFF,0xFF,0xFF},
		{0xFF,0xF8,0xF7,0xF7,0xF8,0xFF,0xFF,0xFF},/*"0",16*/
	},
	{
		{0xFF,0xFF,0xEF,0x07,0xFF,0xFF,0xFF,0xFF},
		{0xFF,0xFF,0xFF,0xF0,0xFF,0xFF,0xFF,0xFF},/*"1",17*/
	},
	{
		{0xFF,0xCF,0xF7,0x77,0x8F,0xFF,0xFF,0xFF},
		{0xFF,0xF3,0xF4,0xF7,0xF7,0xFF,0xFF,0xFF},/*"2",18*/
	},
	{
		{0xFF,0xCF,0x77,0x77,0x8F,0xFF,0xFF,0xFF},
		{0xFF,0xF9,0xF7,0xF7,0xF8,0xFF,0xFF,0xFF},/*"3",19*/
	},
	{
		{0xFF,0xFF,0x3F,0xCF,0x07,0xFF,0xFF,0xFF},
		{0xFF,0xFC,0xFD,0xFD,0xF0,0xFD,0xFF,0xFF},/*"4",20*/
	},
	{
		{0xFF,0x07,0xB7,0xB7,0x77,0xFF,0xFF,0xFF},
		{0xFF,0xF9,0xF7,0xF7,0xF8,0xFF,0xFF,0xFF},/*"5",21*/
	},
	{
		{0xFF,0x0F,0x77,0x77,0xCF,0xFF,0xFF,0xFF},
		{0xFF,0xF8,0xF7,0xF7,0xF8,0xFF,0xFF,0xFF},/*"6",22*/
	},
	{
		{0xFF,0xF7,0xF7,0x37,0xC7,0xFF,0xFF,0xFF},
		{0xFF,0xFF,0xF1,0xFE,0xFF,0xFF,0xFF,0xFF},/*"7",23*/
	},
	{
		{0xFF,0x8F,0x77,0x77,0x8F,0xFF,0xFF,0xFF},
		{0xFF,0xF8,0xF7,0xF7,0xF8,0xFF,0xFF,0xFF},/*"8",24*/
	},
	{
		{0xFF,0x8F,0x77,0x77,0x0F,0xFF,0xFF,0xFF},
		{0xFF,0xF9,0xF7,0xF7,0xF8,0xFF,0xFF,0xFF},/*"9",25*/
	},
	{
		{0xFF,0xFF,0x9F,0x9F,0xFF,0xFF,0xFF,0xFF},
		{0xFF,0xFF,0xF3,0xF3,0xFF,0xFF,0xFF,0xFF},/*":",26*/
	},
	{
		{0xFF,0xFF,0x9F,0x9F,0xFF,0xFF,0xFF,0xFF},
		{0xFF,0xFF,0xEB,0xF3,0xFF,0xFF,0xFF,0xFF},/*";",27*/
	},
	{
		{0xFF,0x7F,0xBF,0xDF,0xEF,0xF7,0xFF,0xFF},
		{0xFF,0xFF,0xFE,0xFD,0xFB,0xF7,0xFF,0xFF},/*"<",28*/
	},
	{
		{0xFF,0xDF,0xDF,0xDF,0xDF,0xFF,0xFF,0xFF},
		{0xFF,0xFE,0xFE,0xFE,0xFE,0xFF,0xFF,0xFF},/*"=",29*/
	},
	{
		{0xFF,0xF7,0xEF,0xDF,0xBF,0x7F,0xFF,0xFF},
		{0xFF,0xF7,0xFB,0xFD,0xFE,0xFF,0xFF,0xFF},/*">",30*/
	},
	{
		{0xFF,0xCF,0xF7,0x77,0x8F,0xFF,0xFF,0xFF},
		{0xFF,0xFF,0xFF,0xF2,0xFF,0xFF,0xFF,0xFF},/*"?",31*/
	},
	{
		{0xFF,0x0F,0xD7,0x17,0xF7,0x0F,0xFF,0xFF},
		{0xFF,0xF8,0xF6,0xF6,0xF5,0xFA,0xFF,0xFF},/*"@",32*/
	},
	{
		{0xFF,0xFF,0x1F,0xE7,0x1F,0xFF,0xFF,0xFF},
		{0xFF,0xF0,0xFD,0xFD,0xFD,0xF0,0xFF,0xFF},/*"A",33*/
	},
	{
		{0xFF,0x07,0x77,0x77,0x77,0x8F,0xFF,0xFF},
		{0xFF,0xF0,0xF7,0xF7,0xF7,0xF8,0xFF,0xFF},/*"B",34*/
	},
	{
		{0xFF,0x0F,0xF7,0xF7,0xF7,0xCF,0xFF,0xFF},
		{0xFF,0xF8,0xF7,0xF7,0xF7,0xF9,0xFF,0xFF},/*"C",35*/
	},
	{
		{0xFF,0x07,0xF7,0xF7,0xEF,0x1F,0xFF,0xFF},
		{0xFF,0xF0,0xF7,0xF7,0xFB,0xFC,0xFF,0xFF},/*"D",36*/
	},
	{
		{0xFF,0x07,0x77,0x77,0x77,0xF7,0xFF,0xFF},
		{0xFF,0xF0,0xF7,0xF7,0xF7,0xF7,0xFF,0xFF},/*"E",37*/
	},
	{
		{0xFF,0x07,0x77,0x77,0x77,0xF7,0xFF,0xFF},
		{0xFF,0xF0,0xFF,0xFF,0xFF,0xFF,0xFF,0xFF},/*"F",38*/
	},
	{
		{0xFF,0x0F,0xF7,0xF7,0xF7,0xCF,0xFF,0xFF},
		{0xFF,0xF8,0xF7,0xF7,0xFA,0xF0,0xFF,0xFF},/*"G",39*/
	},
	{
		{0xFF,0x07,0x7F,0x7F,0x7F,0x07,0xFF,0xFF},
		{0xFF,0xF0,0xFF,0xFF,0xFF,0xF0,0xFF,0xFF},/*"H",40*/
	},
	{
		{0xFF,0xFF,0xF7,0x07,0xF7,0xFF,0xFF,0xFF},
		{0xFF,0xFF,0xF7,0xF0,0xF7,0xFF,0xFF,0xFF},/*"I",41*/
	},
	{
		{0xFF,0xFF,0xFF,0xFF,0x07,0xFF,0xFF,0xFF},
		{0xFF,0xF9,0xF7,0xF7,0xF8,0xFF,0xFF,0xFF},/*"J",42*/
	},
	{
		{0xFF,0x07,0x7F,0x9F,0xE7,0xFF,0xFF,0xFF},
		{0xFF,0xF0,0xFF,0xFC,0xF3,0xFF,0xFF,0xFF},/*"K",43*/
	},
	{
		{0xFF,0x07,0xFF,0xFF,0xFF,0xFF,0xFF,0xFF},
		{0xFF,0xF0,0xF7,0xF7,0xF7,0xF7,0xFF,0xFF},/*"L",44*/
	},
	{
		{0xFF,0x07,0x1F,0xFF,0x1F,0x07,0xFF,0xFF},
		{0xFF,0xF0,0xFF,0xF0,0xFF,0xF0,0xFF,0xFF},/*"M",45*/
	},
	{
		{0xFF,0x07,0xCF,0x3F,0xFF,0x07,0xFF,0xFF},
		{0xFF,0xF0,0xFF,0xFE,0xF9,0xF0,0xFF,0xFF},/*"N",46*/
	},
	{
		{0xFF,0x0F,0xF7,0xF7,0xF7,0x0F,0xFF,0xFF},
		{0xFF,0xF8,0xF7,0xF7,0xF7,0xF8,0xFF,0xFF},/*"O",47*/
	},
	{
		{0xFF,0x07,0x77,0x77,0x77,0x8F,0xFF,0xFF},
		{0xFF,0xF0,0xFF,0xFF,0xFF,0xFF,0xFF,0xFF},/*"P",48*/
	},
	{
		{0xFF,0x0F,0xF7,0xF7,0xF7,0x0F,0xFF,0xFF},
		{0xFF,0xF8,0xF7,0xF5,0xFB,0xF4,0xFF,0xFF},/*"Q",49*/
	},
	{
		{0xFF,0x07,0x77,0x77,0x77,0x8F,0xFF,0xFF},
		{0xFF,0xF0,0xFF,0xFF,0xFE,0xF1,0xFF,0xFF},/*"R",50*/
	},
	{
		{0xFF,0xCF,0xB7,0x77,0xF7,0xCF,0xFF,0xFF},
		{0xFF,0xF9,0xF7,0xF7,0xF6,0xF9,0xFF,0xFF},/*"S",51*/
	},
	{
		{0xFF,0xF7,0xF7,0x07,0xF7,0xF7,0xFF,0xFF},
		{0xFF,0xFF,0xFF,0xF0,0xFF,0xFF,0xFF,0xFF},/*"T",52*/
	},
	{
		{0xFF,0x07,0xFF,0xFF,0xFF,0x07,0xFF,0xFF},
		{0xFF,0xF8,0xF7,0xF7,0xF7,0xF8,0xFF,0xFF},/*"U",53*/
	},
	{
		{0xFF,0xC7,0x3F,0xFF,0x3F,0xC7,0xFF,0xFF},
		{0xFF,0xFF,0xFE,0xF1,0xFE,0xFF,0xFF,0xFF},/*"V",54*/
	},
	{
		{0xFF,0x07,0xFF,0x07,0xFF,0x07,0xFF,0xFF},
		{0xFF,0xFF,0xF0,0xFF,0xF0,0xFF,0xFF,0xFF},/*"W",55*/
	},
	{
		{0xFF,0xE7,0x9F,0x7F,0x9F,0xE7,0xFF,0xFF},
		{0xFF,0xF3,0xFC,0xFF,0xFC,0xF3,0xFF,0xFF},/*"X",56*/
	},
	{
		{0xFF,0xE7,0x9F,0x7F,0x9F,0xE7,0xFF,0xFF},
		{0xFF,0xFF,0xFF,0xF0,0xFF,0xFF,0xFF,0xFF},/*"Y",57*/
	},
	{
		{0xFF,0xF7,0xF7,0x77,0x97,0xE7,0xFF,0xFF},
		{0xFF,0xF3,0xF4,0xF7,0xF7,0xF7,0xFF,0xFF},/*"Z",58*/
	},
	{
		{0xFF,0xFF,0xFF,0x03,0xFB,0xFB,0xFF,0xFF},
		{0xFF,0xFF,0xFF,0xE0,0xEF,0xEF,0xFF,0xFF},/*"[",59*/
	},
	{
		{0xFF,0xF3,0xCF,0x3F,0xFF,0xFF,0xFF,0xFF},
		{0xFF,0xFF,0xFF,0xFE,0xF9,0xE7,0xFF,0xFF},/*"\",60*/
	},
	{
		{0xFF,0xFB,0xFB,0x03,0xFF,0xFF,0xFF,0xFF},
		{0xFF,0xEF,0xEF,0xE0,0xFF,0xFF,0xFF,0xFF},/*"]",61*/
	},
	{
		{0xFF,0xFF,0xF7,0xFB,0xF7,0xFF,0xFF,0xFF},
		{0xFF,0xFF,0xFF,0xFF,0xFF,0xFF,0xFF,0xFF},/*"^",62*/
	},
	{
		{0xFF,0xFF,0xFF,0xFF,0xFF,0xFF,0xFF,0xFF},
		{0xEF,0xEF,0xEF,0xEF,0xEF,0xEF,0xFF,0xFF},/*"_",63*/
	},
	{
		{0xFF,0xFF,0xFB,0xF7,0xFF,0xFF,0xFF,0xFF},
		{0xFF,0xFF,0xFF,0xFF,0xFF,0xFF,0xFF,0xFF},/*"`",64*/
	},
	{
		{0xFF,0x7F,0xBF,0xBF,0x7F,0xFF,0xFF,0xFF},
		{0xFF,0xF9,0xF6,0xF6,0xF8,0xF7,0xFF,0xFF},/*"a",65*/
	},
	{
		{0xFF,0x07,0xBF,0xBF,0xBF,0x7F,0xFF,0xFF},
		{0xFF,0xF0,0xF7,0xF7,0xF7,0xF8,0xFF,0xFF},/*"b",66*/
	},
	{
		{0xFF,0x7F,0xBF,0xBF,0xBF,0x7F,0xFF,0xFF},
		{0xFF,0xF8,0xF7,0xF7,0xF7,0xFB,0xFF,0xFF},/*"c",67*/
	},
	{
		{0xFF,0x7F,0xBF,0xBF,0xBF,0x07,0xFF,0xFF},
		{0xFF,0xF8,0xF7,0xF7,0xF7,0xF0,0xFF,0xFF},/*"d",68*/
	},
	{
		{0xFF,0x7F,0xBF,0xBF,0xBF,0x7F,0xFF,0xFF},
		{0xFF,0xF8,0xF6,0xF6,0xF6,0xFA,0xFF,0xFF},/*"e",69*/
	},
	{
		{0xFF,0xBF,0x0F,0xB7,0xF7,0xFF,0xFF,0xFF},
		{0xFF,0xFF,0xF0,0xFF,0xFF,0xFF,0xFF,0xFF},/*"f",70*/
	},
	{
		{0xFF,0x7F,0xBF,0xBF,0x7F,0xBF,0xFF,0xFF},
		{0xFF,0xF5,0xEA,0xEA,0xEB,0xF7,0xFF,0xFF},/*"g",71*/
	},
	{
		{0xFF,0x07,0xBF,0xBF,0xBF,0x7F,0xFF,0xFF},
		{0xFF,0xF0,0xFF,0xFF,0xFF,0xF0,0xFF,0xFF},/*"h",72*/
	},
	{
		{0xFF,0xFF,0xFF,0x27,0xFF,0xFF,0xFF,0xFF},
		{0xFF,0xFF,0xFF,0xF0,0xFF,0xFF,0xFF,0xFF},/*"i",73*/
	},
	{
		{0xFF,0xFF,0xFF,0x27,0xFF,0xFF,0xFF,0xFF},
		{0xFF,0xEF,0xEF,0xF0,0xFF,0xFF,0xFF,0xFF},/*"j",74*/
	},
	{
		{0xFF,0x07,0xFF,0xFF,0x7F,0xBF,0xFF,0xFF},
		{0xFF,0xF0,0xFD,0xFC,0xFB,0xF7,0xFF,0xFF},/*"k",75*/
	},
	{
		{0xFF,0xFF,0xFF,0x07,0xFF,0xFF,0xFF,0xFF},
		{0xFF,0xFF,0xFF,0xF0,0xFF,0xFF,0xFF,0xFF},/*"l",76*/
	},
	{
		{0xFF,0x3F,0xBF,0x7F,0xBF,0x7F,0xFF,0xFF},
		{0xFF,0xF0,0xFF,0xF0,0xFF,0xF0,0xFF,0xFF},/*"m",77*/
	},
	{
		{0xFF,0x3F,0xBF,0xBF,0xBF,0x7F,0xFF,0xFF},
		{0xFF,0xF0,0xFF,0xFF,0xFF,0xF0,0xFF,0xFF},/*"n",78*/
	},
	{
		{0xFF,0x7F,0xBF,0xBF,0xBF,0x7F,0xFF,0xFF},
		{0xFF,0xF8,0xF7,0xF7,0xF7,0xF8,0xFF,0xFF},/*"o",79*/
	},
	{
		{0xFF,0x3F,0xBF,0xBF,0xBF,0x7F,0xFF,0xFF},
		{0xFF,0xE0,0xFB,0xFB,0xFB,0xFC,0xFF,0xFF},/*"p",80*/
	},
	{
		{0xFF,0x7F,0xBF,0xBF,0xBF,0x3F,0xFF,0xFF},
		{0xFF,0xFC,0xFB,0xFB,0xFB,0xE0,0xFF,0xFF},/*"q",81*/
	},
	{
		{0xFF,0xFF,0x3F,0x7F,0xBF,0xBF,0xFF,0xFF},
		{0xFF,0xFF,0xF0,0xFF,0xFF,0xFF,0xFF,0xFF},/*"r",82*/
	},
	{
		{0xFF,0x7F,0xBF,0xBF,0xBF,0x7F,0xFF,0xFF},
		{0xFF,0xFB,0xF6,0xF6,0xF5,0xFB,0xFF,0xFF},/*"s",83*/
	},
	{
		{0xFF,0xBF,0x07,0xBF,0xFF,0xFF,0xFF,0xFF},
		{0xFF,0xFF,0xF8,0xF7,0xF7,0xFF,0xFF,0xFF},/*"t",84*/
	},
	{
		{0xFF,0x3F,0xFF,0xFF,0xFF,0x3F,0xFF,0xFF},
		{0xFF,0xF8,0xF7,0xF7,0xF7,0xF0,0xFF,0xFF},/*"u",85*/
	},
	{
		{0xFF,0x3F,0xFF,0xFF,0xFF,0x3F,0xFF,0xFF},
		{0xFF,0xFF,0xFC,0xF3,0xFC,0xFF,0xFF,0xFF},/*"v",86*/
	},
	{
		{0xFF,0x3F,0xFF,0x3F,0xFF,0x3F,0xFF,0xFF},
		{0xFF,0xFE,0xF1,0xFE,0xF1,0xFE,0xFF,0xFF},/*"w",87*/
	},
	{
		{0xFF,0xBF,0x7F,0xFF,0x7F,0xBF,0xFF,0xFF},
		{0xFF,0xF7,0xFB,0xFC,0xFB,0xF7,0xFF,0xFF},/*"x",88*/
	},
	{
		{0xFF,0x3F,0xFF,0xFF,0xFF,0x3F,0xFF,0xFF},
		{0xFF,0xEF,0xEC,0xF3,0xFC,0xFF,0xFF,0xFF},/*"y",89*/
	},
	{
		{0xFF,0xBF,0xBF,0xBF,0xBF,0x3F,0xFF,0xFF},
		{0xFF,0xF7,0xF3,0xF5,0xF6,0xF7,0xFF,0xFF},/*"z",90*/
	},
	{
		{0xFF,0xFF,0x7F,0x83,0xFB,0xFF,0xFF,0xFF},
		{0xFF,0xFF,0xFF,0xE0,0xEF,0xFF,0xFF,0xFF},/*"{",91*/
	},
	{
		{0xFF,0xFF,0xFF,0x01,0xFF,0xFF,0xFF,0xFF},
		{0xFF,0xFF,0xFF,0xE0,0xFF,0xFF,0xFF,0xFF},/*"|",92*/
	},
	{
		{0xFF,0xFF,0xFB,0x83,0x7F,0xFF,0xFF,0xFF},
		{0xFF,0xFF,0xEF,0xE0,0xFF,0xFF,0xFF,0xFF},/*"}",93*/
	},
	{
		{0xFF,0xF7,0xFB,0xFB,0xF7,0xFB,0xFF,0xFF},
		{0xFF,0xFF,0xFF,0xFF,0xFF,0xFF,0xFF,0xFF},/*"~",94*/
	}	
};


U8_T const code nAsciiDot[96][2][6] =  {

{0x00,0x00,0x00,0x00,0x00,0x00,0x00,0x00,0x00,0x00,0x00,0x00},/*" ",0*/

{0x00,0x00,0xF8,0x00,0x00,0x00,0x00,0x00,0x33,0x00,0x00,0x00},/*"!",1*/
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{0x00,0x00,0x80,0x7E,0x02,0x00,0x00,0x00,0x00,0x3F,0x40,0x00},/*"{",91*/

//{0x00,0x00,0x00,0xFF,0x00,0x00,0x00,0x00,0x00,0xFF,0x00,0x00},/*"|",92*/
{0x1C,0x22,0x1C,0xC0,0x40,0x40,0x00,0x00,0x00,0x3F,0x02,0x02},/*"未命名文件",DEG AND F*/

//{0x00,0x02,0x7E,0x80,0x00,0x00,0x00,0x40,0x3F,0x00,0x00,0x00},/*"}",93*/
{0xF8,0xF0,0xE0,0xC0,0x80,0x00,0x0F,0x07,0x03,0x01,0x00,0x00},/*"未命名文件",0 */

//{0x06,0x01,0x02,0x04,0x04,0x03,0x00,0x00,0x00,0x00,0x00,0x00},/*"~",94*/ 
{0x1C,0x22,0x1C,0x80,0x40,0x40,0x00,0x00,0x00,0x1F,0x20,0x20},/*"未命名文件",DEG AND C */

{0x00,0x00,0x00,0xFF,0x00,0x00,0x00,0x00,0x00,0xFF,0x00,0x00},/*"|",95*/



};


void Lcd_Write_Byte(U8_T num) //from high to low
{
	S8_T i;
	LCD_CS = 0;
	_nop_();
	LCD_A0 = 1;
	_nop_();	
	for(i = 0;i < 8;i++)
	{
		if(num & 0x80)	LCD_DATA = 1;
     	else       	LCD_DATA = 0;
		
		_nop_();	
     	LCD_CLK = 0;
		_nop_();
		LCD_CLK = 1;
		_nop_();

     	num <<= 1;	
	}
	_nop_();
	LCD_CS = 1;	 _nop_();
	LCD_DATA = 1;
	_nop_();
}


void Lcd_Write_Command(U8_T command) //from high to low
{
	S8_T i;
	LCD_CS = 0;
	_nop_();
	LCD_A0 = 0;
	_nop_();	
	for(i = 0;i < 8;i++)
	{
		if(command & 0x80)	LCD_DATA = 1;
     		else       		LCD_DATA = 0;
			
		_nop_();
     	LCD_CLK = 0;
		_nop_();

		LCD_CLK = 1;
		_nop_();

     	command <<= 1;
	}
	_nop_();
	LCD_CS = 1;
	LCD_DATA = 1;
	_nop_();	
	_nop_();
}



void Lcd_Write_Char(U8_T row,U8_T line,U8_T num,U8_T mode) // row: 0 - 4 , line: 0 - 21
{

	U8_T loop; 
	U8_T index = num - ' ';
	
	Lcd_Write_Command(0x07);	
	Lcd_Set_X_Addr((line + 1) * 6);
	Lcd_Set_Y_Addr(row * 2);
	for(loop = 0;loop < 6;loop++) 
		if(mode == 1)	Lcd_Write_Byte(nAsciiDot[index][0][loop]);  // Normal
		else  Lcd_Write_Byte(~nAsciiDot[index][0][loop]);			// inverse
	Lcd_Set_X_Addr((line + 1) * 6);
	Lcd_Set_Y_Addr(row * 2+1);
	for(loop = 0;loop < 6;loop++) 
		if(mode == 1)	Lcd_Write_Byte(nAsciiDot[index][1][loop]);  // Normal
		else Lcd_Write_Byte(~nAsciiDot[index][1][loop]);			// inverse
	Lcd_Write_Command(0x06);

}

void Lcd_Set_Fuction(U8_T mode)
{
	U8_T fuction;
	fuction = 0x38 + mode;//0x20 + mode;
	Lcd_Write_Command(fuction);
}

void Lcd_Set_Y_Addr(U8_T page)// 0 1 0 0        page 0 - 9
{
	U8_T addr;
	Lcd_Set_Fuction(0);
	addr = 0x40 + page;
	Lcd_Write_Command(addr);
}

void Lcd_Set_X_Addr(U8_T line)// 1 1 1 0/1        page 0 - 129
{
	U8_T addr;
	U8_T line_low;
	U8_T line_high;
	Lcd_Set_Fuction(0);
	line_low = line & 0x0f;
	line = line >> 4;
	line_high = line; 
	addr = 0xe0 + line_low; //low
	Lcd_Write_Command(addr);
	addr = 0xf0 + line_high; //high
	Lcd_Write_Command(addr);
}

#if (ARM_MINI || ARM_CM5 || ARM_WIFI)

void LCD_IO_config(void)
{
    //GPIO端口设置
  GPIO_InitTypeDef GPIO_InitStructure;
	 
	RCC_APB2PeriphClockCmd(RCC_APB2Periph_GPIOD | RCC_APB2Periph_GPIOF | RCC_APB2Periph_GPIOG, ENABLE);	//使能USART1，GPIOA时钟

	//   PD6 PD8 PD9 PD10 PG6 PF11
	GPIO_InitStructure.GPIO_Pin = GPIO_Pin_6 | GPIO_Pin_8 | GPIO_Pin_9 | GPIO_Pin_10 | GPIO_Pin_3;				
	GPIO_InitStructure.GPIO_Speed = GPIO_Speed_50MHz;
	GPIO_InitStructure.GPIO_Mode = GPIO_Mode_Out_PP;			//普通推挽输出
	GPIO_Init(GPIOD, &GPIO_InitStructure);					
 
	// PG6 
	GPIO_InitStructure.GPIO_Pin = GPIO_Pin_6;				//PG.6
	GPIO_InitStructure.GPIO_Speed = GPIO_Speed_50MHz;
	GPIO_InitStructure.GPIO_Mode = GPIO_Mode_Out_PP;	//普通推挽输出
	GPIO_Init(GPIOG, &GPIO_InitStructure);	
  GPIO_SetBits(GPIOG, GPIO_Pin_6);	
	
	// PF11
	GPIO_InitStructure.GPIO_Pin = GPIO_Pin_11;				//PF.11
	GPIO_InitStructure.GPIO_Speed = GPIO_Speed_50MHz;
	GPIO_InitStructure.GPIO_Mode = GPIO_Mode_Out_PP;		//普通推挽输出
	GPIO_Init(GPIOF, &GPIO_InitStructure);					
	GPIO_SetBits(GPIOF, GPIO_Pin_11);	
                  				
}


#endif


void Lcd_Initial(void)
{

#if (ARM_MINI || ARM_CM5 || ARM_WIFI)
	if((Modbus.mini_type == MINI_BIG) || (Modbus.mini_type == MINI_BIG_ARM))
		LCD_IO_config();
#endif	

	LCD_RESET = 0;
	DELAY_Us(1000);
	LCD_RESET = 1;
	DELAY_Us(100);

	
	Lcd_Set_Fuction(1); // 0x21		 
	//DELAY_Us(10);
	Lcd_Write_Command(CMD_SET_BIAS);  //DELAY_Us(10);
	Lcd_Write_Command(CMD_SET_V0);	 //DELAY_Us(10);
	Lcd_Write_Command(CMD_DISPLAY_CONFIG); //DELAY_Us(10);
	
	Lcd_Set_Fuction(0); //DELAY_Us(10); // 0x20
	Lcd_Write_Command(CMD_SET_V0Range_HIGH);  //DELAY_Us(10);  
	Lcd_Write_Command(CMD_DISPLAT_NORMAL); //DELAY_Us(10);
	Lcd_Set_X_Addr(0); //DELAY_Us(10); //0xf0 0xe0
	Lcd_Set_Y_Addr(0); //DELAY_Us(10); //0x40	

	Lcd_All_Off();
	
}

void Lcd_All_Off(void)
{
	U16_T i;
	Lcd_Write_Command(0x07);
	for(i = 0;i < 130*80;i++)	
	{
		Lcd_Write_Byte(0x00);
	}
	Lcd_Write_Command(0x06);
}

void Lcd_Show_String(U16_T pos_x, U16_T pos_y, char* str,U8_T mode,U8_T format,U16_T dcolor,U16_T bgcolor)
{
 	U8_T loop;	
	U8_T len = format & 0x7f; /* the higest bit is for selecting capital or uncial, the real lenght is "format & 0x7f" */
	U8_T str_len;
	U8_T real_len;
	S8_T far tempstr[21];
	if(len > 21)	len = 21;
	if(strlen(str) > 21) str_len = 21;
	else	str_len = strlen(str);
	if(strlen(str) > 21)   real_len = 14;
	else
		real_len = strlen(str);
	for(loop = 0;loop < real_len;loop++)
	{ /* check the higheset bit, it is for capital or uncial */
		if(format & 0x80)	tempstr[loop] = (S8_T)toupper(str[loop]); /* capital */
		else tempstr[loop] = str[loop]; /* uncial */
	}

	/* if the real len is bigger than the strings, using space to fill the residual area*/
	if(len > real_len)
	{	
			/* fill space */
		for(loop = strlen(str);loop < len;loop++)
		{
			Lcd_Write_Char(pos_x,pos_y + loop,' ',mode);
		}	
			/* copy read data to LCD buffer */
		for(loop = 0;loop < strlen(str);loop++)
		{
			Lcd_Write_Char(pos_x,pos_y + loop,tempstr[loop],mode);		
		}
	}
	/* if the real len is less than the string, cut the string */
	/* if len is 0, using string len */
	else
	{	
		if(len == 0)	len = real_len;	
		for(loop = 0;loop < len;loop++)
		{
			Lcd_Write_Char(pos_x,pos_y + loop,tempstr[loop],mode);
		}
	}
}



void Lcd_Show_Data(U8_T pos_x,U8_T pos_y,U16_T number,U8_T dot,U8_T mode) //,S8_T div, bool signed)
{
	S8_T  far loop = 0;
	S8_T far num[5];
	S8_T  far length;
	S8_T far  by_x,by_y;

	by_x = pos_x;
	by_y = pos_y;	

	//number = number / div;

	if(number >= 1000)	length = 4;
	else if(number >= 100)	length = 3;
	else if(number >= 10)	length = 2;
	else length = 1;

	if((length > 1) && (dot != 0)) 
	{
		length ++;	
		num[dot] = '.';
		num[4] = number / 1000; 	number = number % 1000;
		switch(dot)
		{
			case 3:
					num[2] = number / 100; 		number = number % 100;
					num[1] = number / 10; 		number = number % 10;
					num[0] = number;
					break;
			case 2:
					num[3] = number / 100; 		number = number % 100;
					num[1] = number / 10; 		number = number % 10;
					num[0] = number;
					break;
			case 1:
					num[3] = number / 100; 		number = number % 100;
					num[2] = number / 10; 		number = number % 10;
					num[0] = number;
					break;
		}

	}
	else
	{
		num[3] = number / 1000; 	number = number % 1000;
		num[2] = number / 100; 		number = number % 100;
		num[1] = number / 10; 		number = number % 10;
		num[0] = number;
	}	

//	Lcd_Write_Command(0x07);	
	for(loop = length - 1;loop >= 0;loop--)
	{
		if(num[loop] == '.')	Lcd_Write_Char(by_x,by_y,'.',mode);
		else
		Lcd_Write_Char(by_x,by_y,aby_Char_Table[num[loop]],mode);
		by_y ++;
		if(by_y >= 21)
		{
			by_y = 0;
			by_x ++;
			if(by_x >= 5)	by_x = 0;
		}
	}
	if(length < 4)
	for(loop = 4;loop >= length;loop--)
	{
		 Lcd_Write_Char(by_x,by_y - length + loop,' ',mode);
	}	
//	Lcd_Write_Command(0x06);
		
}

#if (ASIX_MINI || ASIX_CM5)
S8_T far scroll_message[200];
S8_T far scroll_message_length;

bit scrolling_flag = TRUE;

void start_scrolling(void)
{
	scrolling_flag = TRUE;
}

void stop_scrolling(void)
{
	scrolling_flag = FALSE;
}



U8_T const code network_status_text[] = "  NETWORK:";
U8_T const code main_net_status_text[] = " Main net:";
U8_T const code sub_net_status_text[] = " Subnet:";
U8_T const code net_status_ok_text[] = "OK";
U8_T const code net_status_dead_text[] = "Dead";
U8_T const code net_offline_text[] = "Offline";
U8_T const code alarm_text[] = "  ALARM:";

void update_message_context(void)
{
	U8_T length;

	if(scrolling_flag == 1)
	{	  
	scroll_message_length = 0;

	length = sizeof(time) - 1;
	get_time_text();
	memcpy(scroll_message + scroll_message_length, time, length);
	scroll_message_length += length;

// Network
	length = sizeof(network_status_text) - 1;
	memcpy(scroll_message + scroll_message_length, network_status_text, length);
	scroll_message_length += length;
	// main net status
	length = sizeof(main_net_status_text) - 1;
	memcpy(scroll_message + scroll_message_length, main_net_status_text, length);
	scroll_message_length += length;
	//if(main_net_status_ctr)
	{
		length = sizeof(net_status_ok_text) - 1;
		memcpy(scroll_message + scroll_message_length, net_status_ok_text, length);
		scroll_message_length += length;
	}
	/*else
	{
		length = sizeof(net_status_dead_text) - 1;
		memcpy(message + scroll_message_length, net_status_dead_text, length);
		scroll_message_length += length;
	}*/
	// sub net status
	length = sizeof(sub_net_status_text) - 1;
	memcpy(scroll_message + scroll_message_length, sub_net_status_text, length);
	scroll_message_length += length;
	//if(db_ctr == current_online_ctr)
	{
		length = sizeof(net_status_ok_text) - 1;
		memcpy(scroll_message + scroll_message_length, net_status_ok_text, length);
		scroll_message_length += length;
	}
	/*else
	{
		U8_T data i, id_temp;
		for(i = 1; i < db_ctr; i++)
		{
			id_temp = read_eeprom(SCAN_DB_START_ADDR + 5*i);
			if((current_online[id_temp / 8] & (1 << (id_temp % 8))) == 0x00)
			{
				strcpy(text, external_text);
				itoa(id_temp, int_text);
//				sprintf(int_text, "%u", id_temp);
				strcat(text, int_text);
				strcat(text, " ");

				length = strlen(text);
				memcpy(message + scroll_message_length, text, length);
				scroll_message_length += length;
			}
		}

		length = sizeof(net_offline_text) - 1;
		memcpy(message + scroll_message_length, net_offline_text, length);
		scroll_message_length += length;
	}  */

// Alarm
	length = sizeof(alarm_text) - 1;
	memcpy(scroll_message + scroll_message_length, alarm_text, length);
	scroll_message_length += length;


// SPACE
	length = 3;
	memcpy(scroll_message + scroll_message_length, "   ", length);
	scroll_message_length += length;
	}

}


void display_character_with_start_bit(U8_T row, U8_T start_line, U8_T start_bit, U8_T end_bit, U8_T c, U8_T disp_mode)
{
	U8_T i;
	U8_T index = c - ' ';

	if(start_line >= 130)
		return;
	Lcd_Write_Command(0x07);	
	Lcd_Set_X_Addr(start_line);
	Lcd_Set_Y_Addr(row * 2);
	for(i = start_bit; i < end_bit; i++)
	{ 
		if(disp_mode == NORMAL)
			Lcd_Write_Byte(Dot8_16[index][0][i]);
		else
			Lcd_Write_Byte(~Dot8_16[index][0][i]);
	}

	
	Lcd_Set_X_Addr(start_line);
	Lcd_Set_Y_Addr(row * 2 + 1);
	for(i = start_bit; i < end_bit; i++)
	{ 
		if(disp_mode == NORMAL)
			Lcd_Write_Byte(Dot8_16[index][1][i]);
		else
			Lcd_Write_Byte(~Dot8_16[index][1][i]);
	}
	Lcd_Write_Command(0x06);
}

void scrolling_message(void)
{
	S8_T i, disp_value, byte_index;
	static S8_T start_bit = 0;
	static S8_T start_byte = 0;

	if(scrolling_flag != FALSE)
	{//	return;

	byte_index = start_byte;

	disp_value = scroll_message[byte_index++];
	byte_index %= scroll_message_length;
	display_character_with_start_bit(4, 0, start_bit, 8, disp_value, NORMAL);
	if(start_bit < 7)
	{
		for(i = 1; i < 16; i++)
		{
			disp_value = scroll_message[byte_index++];
			byte_index %= scroll_message_length;
			display_character_with_start_bit(4, 8 * i - start_bit, 0, 8, disp_value, NORMAL);
		}
	
		disp_value = scroll_message[byte_index++];
		byte_index %= scroll_message_length;
		display_character_with_start_bit(4, 8 * i - start_bit, 0, 4 + start_bit, disp_value, NORMAL);
	}
	else // if(start_bit == 7)
	{
		for(i = 1; i < 17; i++)
		{
			disp_value = scroll_message[byte_index++];
			byte_index %= scroll_message_length;
			display_character_with_start_bit(4, 8 * i - start_bit, 0, 8, disp_value, NORMAL);
		}
	
		disp_value = scroll_message[byte_index++];
		byte_index %= scroll_message_length;
		display_character_with_start_bit(4, 8 * i - start_bit, 0, start_bit - 2, disp_value, NORMAL);
	} 

	start_bit++;
	if(start_bit >= 8)
	{
		start_bit = 0;
		start_byte++;
		start_byte %= scroll_message_length;
	}
	}
}
#endif


#endif
