//----------------------------------------------------------------------
/*EASTRISING TECHNOLOGY CO,.LTD.*/
// Module       : ER-TFT024-3 
// Lanuage      : C51 Code
// Create       : JAVEN
// Version	: 1.0
// Date         : Jun-12-2014
// LCM Drive IC : ILI9341
// INTERFACE    : 4_Wire-SPI
// MCU          : STC89LV52
// VDD          : 2.8V                 
//*************************************************************************** 
//
//#include"stc89.h"
//#include <stdio.h>
//#include <intrins.h>

//=============================================================
////DEFINE LCD PIN IO
//sbit LCD_CS=P1^0;		//CHIP SELECT
//sbit LCD_SCL=P1^1;		//SERIAL CLOCK INPUT 
//sbit LCD_SDA=P1^2;	     //SERIAL DATA INPUT/OUTPUT
//sbit LCD_RES=P1^4;		//RESET SIGNAL INPUT
//sbit LCD_RS=P1^5;		//  D/C    DATA/COMMAND SELECT
//====================================================//
#include "main.h"

#if (ARM_CM5 || ASIX_CM5)

#include "LCD.h"
#include "delay.h"
#include "types.h"

uint8 const code chlibsmall[] = 
{
0x00,0x00,0x00,0x00,0x00,0x00,0x00,0x00,0x00,0x00,0x00,0x00,0x00,0x00,0x00,0x00,
0x00,0x00,0x00,0x00,0x00,0x00,0x00,0x00,0x00,0x00,0x00,0x00,0x00,0x00,0x00,0x00,
0x00,0x00,0x00,0x00,0x00,0x00,0x00,0x00,0x00,0x00,0x00,0x00,0x00,0x00,0x00,0x00,
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0x00,0x00,0x00,0x00,0x00,0x00,0x00,0x00,0x00,0x00,0x00,0x00,/*"~",61*/

};



//unsigned char const chlib[];
//uint8 const athome[];

//void ILI9341_Initial(void);
void Write_Cmd_Data(unsigned char CMDP);
void Write_Cmd(unsigned char CMD);
void Write_Data(unsigned char DH,unsigned char DL);
//void delay_ms(unsigned int tt);
void  Write_Data_U16(unsigned int y);
static void LCD_SetPos(unsigned int x0,unsigned int x1,unsigned  int y0,unsigned int y1);
void ClearScreen(unsigned int bColor);
//void showzifu(unsigned int x,unsigned int y,unsigned char value,unsigned int dcolor,unsigned  int bgcolor);
//void showzifustr(unsigned int x,unsigned int y,unsigned char *str,unsigned int dcolor,unsigned int bgcolor);
void disp_ch(uint8 form, uint16 x, uint16 y,uint8 value,uint16 dcolor,uint16 bgcolor);	
void disp_icon(uint16 cp, uint16 pp, uint8 const *icon_name, uint16 x,uint16 y,uint16 dcolor, uint16 bgcolor);
//===============================================================
//CLEAR SCREEN
void Lcd_All_Off(void)
{
 unsigned int i,j;
 LCD_SetPos(0,319,0,239);//320x240
 for (i=0;i<240;i++)
	{	
		for (j=0;j<320;j++)
	     Write_Data_U16(0xffff);
	}
}




//==============================================================
//WRITE DATA WORD
void  Write_Data_U16(unsigned int y)
{
	unsigned char m,n;
	m=y>>8;
	n=y;
	Write_Data(m,n);

}
//=============================================================
//WRITE COMMAND

void Write_Cmd(unsigned char CMD)
{ unsigned char i;
 	 
    LCD_CS=0;
   	LCD_RS=0;
    for(i=0;i<8;i++)
     {  LCD_SCL=0;
        if(CMD&0x80) LCD_SDA=1;
       	else LCD_SDA=0;
       	LCD_SCL=1;
        CMD=CMD<<1;
     }
   	LCD_CS=1;


}

//===============================================================
//WRITE COMMAND PARAMETER 

void  Write_Cmd_Data (unsigned char CMDP)
{ unsigned char i;
 	 
    LCD_CS=0;
   	LCD_RS=1;
    for(i=0;i<8;i++)
     {  LCD_SCL=0;
        if(CMDP&0x80) LCD_SDA=1;
       	else LCD_SDA=0;
       	LCD_SCL=1;
        CMDP=CMDP<<1;
     }
   	LCD_CS=1;

}


//===================================================================
//WRITE DATA CHAR

void Write_Data(unsigned char DH,unsigned char DL)
{unsigned char i;
 	 
    LCD_CS=0;
   	LCD_RS=1;
    for(i=0;i<8;i++)
     {  LCD_SCL=0;
        if(DH&0x80) LCD_SDA=1;
       	else LCD_SDA=0;
       	LCD_SCL=1;
        DH=DH<<1;
     }

    for(i=0;i<8;i++)
     {  LCD_SCL=0;
        if(DL&0x80) LCD_SDA=1;
       	else LCD_SDA=0;
       	LCD_SCL=1;
        DL=DL<<1;
     }

   	LCD_CS=1;

}



//============================================================
//DELAY
//void delay_ms(unsigned int count)
//{
//    int i,j;                                                                                
//    for(i=0;i<count;i++)                                                                    
//       {
//	     for(j=0;j<125;j++);
//       }                                                                                     
//}

#if ARM_CM5
void LCD_IO_Initial(void)
{
	GPIO_InitTypeDef GPIO_InitStructure;

	RCC_APB2PeriphClockCmd( RCC_APB2Periph_GPIOD | RCC_APB2Periph_GPIOF, ENABLE);
	
	GPIO_InitStructure.GPIO_Pin = GPIO_Pin_6 |GPIO_Pin_8 | GPIO_Pin_9 | GPIO_Pin_10;  
	GPIO_InitStructure.GPIO_Mode = GPIO_Mode_Out_PP;
	GPIO_InitStructure.GPIO_Speed = GPIO_Speed_50MHz;
	GPIO_Init(GPIOD,&GPIO_InitStructure);
	GPIO_ResetBits(GPIOD, GPIO_Pin_6 | GPIO_Pin_8 | GPIO_Pin_9 | GPIO_Pin_10);
	
	GPIO_InitStructure.GPIO_Pin = GPIO_Pin_11 | GPIO_Pin_10;  
	GPIO_InitStructure.GPIO_Mode = GPIO_Mode_Out_PP;
	GPIO_InitStructure.GPIO_Speed = GPIO_Speed_50MHz;
	GPIO_Init(GPIOF,&GPIO_InitStructure);
	GPIO_ResetBits(GPIOF, GPIO_Pin_10);
	GPIO_SetBits(GPIOF,GPIO_Pin_11);
	Test[15]++;
}

#endif

void LCD_Enter_Sleep(void) 
{ 
	Write_Cmd(0x28);     // Display off 
	Write_Cmd(0x10);     // Enter Sleep mode 
} 
 
void LCD_Exit_Sleep(void) 
{ 
	Write_Cmd(0x11);     // Sleep out 
	DELAY_Ms(120); 
	Write_Cmd(0x29);     // Display on 
} 


//=============================================================
//LCD Initial
void Lcd_Initial(void)
{	 
#if ARM_CM5	
	LCD_IO_Initial();	
#endif
	
 	LCD_CS=1;
	DELAY_Ms(5);
	LCD_RES=0;
	DELAY_Ms(10);
	LCD_RES=1;
	DELAY_Ms(120);

	Write_Cmd(0x11);//exsit sleep mode
	DELAY_Ms(120);

 	Write_Cmd(0xCF);   //power control B
	Write_Cmd_Data(0x00); 
	Write_Cmd_Data(0xc3); 
	Write_Cmd_Data(0X30); 
      
 	Write_Cmd(0xED); //power on sequence ontrol  
	Write_Cmd_Data(0x64); 
	Write_Cmd_Data(0x03); 
	Write_Cmd_Data(0X12); 
	Write_Cmd_Data(0X81); 
      
 	Write_Cmd(0xE8); //driver timing control A 
	Write_Cmd_Data(0x85); 
	Write_Cmd_Data(0x10); 
	Write_Cmd_Data(0x79); 
      
 	Write_Cmd(0xCB);//power control A   
	Write_Cmd_Data(0x39); 
	Write_Cmd_Data(0x2C); 
	Write_Cmd_Data(0x00); 
	Write_Cmd_Data(0x34); 
	Write_Cmd_Data(0x02); 
      
 	Write_Cmd(0xF7);//pump ratio control   
	Write_Cmd_Data(0x20); 
      
 	Write_Cmd(0xEA);//driver timing control B   
	Write_Cmd_Data(0x00); 
	Write_Cmd_Data(0x00); 
      
 	Write_Cmd(0xC0);    //Power control 
	Write_Cmd_Data(0x22);   //VRH[5:0] 
      
 	Write_Cmd(0xC1);    //Power control 
	Write_Cmd_Data(0x11);   //SAP[2:0];BT[3:0] 
      
 	Write_Cmd(0xC5);    //VCM control 
	Write_Cmd_Data(0x3d); 
    //LCD_DataWrite_ILI9341(0x30); 
	Write_Cmd_Data(0x20); 
      
 	Write_Cmd(0xC7);    //VCM control2 
    //LCD_DataWrite_ILI9341(0xBD); 
	Write_Cmd_Data(0xAA); //0xB0 
    
 	Write_Cmd(0x36);    // Memory Access Control 
//	Write_Cmd_Data(0x08); //Row address order
	Write_Cmd_Data(0x68);
      
 	Write_Cmd(0x3A);   //color mode
	Write_Cmd_Data(0x55); 
    
 	Write_Cmd(0xB1); //frame rate control  
	Write_Cmd_Data(0x00);   
	Write_Cmd_Data(0x13); 
      
 	Write_Cmd(0xB6);    // Display Function Control 
	Write_Cmd_Data(0x0A); 
	Write_Cmd_Data(0xA2); 
    
 	Write_Cmd(0xF6); //interface control    
	Write_Cmd_Data(0x01); 
//	Write_Cmd_Data(0x00);//data will be ignore if over the range
	Write_Cmd_Data(0x30); 
      
 	Write_Cmd(0xF2);    // 3Gamma Function Disable 
	Write_Cmd_Data(0x00); 
      
 	Write_Cmd(0x26);    //Gamma curve selected 
	Write_Cmd_Data(0x01); 
      
 	Write_Cmd(0xE0);    //Set Gamma 
	Write_Cmd_Data(0x0F); 
	Write_Cmd_Data(0x3F); 
	Write_Cmd_Data(0x2F); 
	Write_Cmd_Data(0x0C); 
	Write_Cmd_Data(0x10); 
	Write_Cmd_Data(0x0A); 
	Write_Cmd_Data(0x53); 
	Write_Cmd_Data(0XD5); 
	Write_Cmd_Data(0x40); 
	Write_Cmd_Data(0x0A); 
	Write_Cmd_Data(0x13); 
	Write_Cmd_Data(0x03); 
	Write_Cmd_Data(0x08); 
	Write_Cmd_Data(0x03); 
	Write_Cmd_Data(0x00); 
      
 	Write_Cmd(0XE1);    //Set Gamma 
	Write_Cmd_Data(0x00); 
	Write_Cmd_Data(0x00); 
	Write_Cmd_Data(0x10); 
	Write_Cmd_Data(0x03); 
	Write_Cmd_Data(0x0F); 
	Write_Cmd_Data(0x05); 
	Write_Cmd_Data(0x2C); 
	Write_Cmd_Data(0xA2); 
	Write_Cmd_Data(0x3F); 
	Write_Cmd_Data(0x05); 
	Write_Cmd_Data(0x0E); 
	Write_Cmd_Data(0x0C); 
	Write_Cmd_Data(0x37); 
	Write_Cmd_Data(0x3C); 
	Write_Cmd_Data(0x0F); 
      
 	Write_Cmd(0x11);    //Exit Sleep 
	DELAY_Ms(120);
 	Write_Cmd(0x29);    //Display on 
	DELAY_Ms(50);

	

}

void Display_Initial_Data(void)
{ 
	Lcd_All_Off();
	ether_rx_packet = 0;
	ether_tx_packet = 0;
	memcpy(time,"2012-09-19 17:16:10",20);

}
	   

//===============================================================
//Define the coordinate
static void LCD_SetPos(unsigned int x0,unsigned int x1,unsigned int y0,unsigned int y1)
{unsigned char YSH,YSL,YEH,YEL;

	YSH=y0>>8;
	YSL=y0;

	YEH=y1>>8;
	YEL=y1;

 	Write_Cmd(0x2A);
	Write_Cmd_Data (x0 >> 8);
	Write_Cmd_Data (x0);
	Write_Cmd_Data (x1 >> 8);
	Write_Cmd_Data (x1);
	Write_Cmd(0x2B);
	Write_Cmd_Data (y0>>8);
	Write_Cmd_Data (y0);
	Write_Cmd_Data (y1>>8);
	Write_Cmd_Data (y1);
	Write_Cmd(0x2C);//LCD_WriteCMD(GRAMWR);
}


void Display_IP(void)
{  	
	char far text[21];
//	U8_T temp1, temp2;
	sprintf(text, "IP:%u.%u.%u.%u", (uint16)Modbus.ip_addr[0], (uint16)Modbus.ip_addr[1], (uint16)Modbus.ip_addr[2], (uint16)Modbus.ip_addr[3]);
	Lcd_Show_String(0, 0, text, NORMAL, 21,0x0000,0xffff);
	// subnet mask address		
//	sprintf(text, "MASK: %u.%u.%u.%u", (uint16)Modbus.subnet[0], (uint16)Modbus.subnet[1], (uint16)Modbus.subnet[2], (uint16)Modbus.subnet[3]);
//	Lcd_Show_String(1, 0, text, NORMAL, 21);
//	// tcp port
//	sprintf(text, "GATE: %u.%u.%u.%u", (uint16)Modbus.getway[0], (uint16)Modbus.getway[1], (uint16)Modbus.getway[2], (uint16)Modbus.getway[3]);
//	Lcd_Show_String(2, 0, text, NORMAL, 21);
	sprintf(text, "SW: %u.%u Port: %u", (uint16)(SW_REV / 100),(uint16)(SW_REV % 100),(uint16)Modbus.tcp_port);
	Lcd_Show_String(1, 0, text, NORMAL, 21,0x0000,0xffff);
	sprintf(text, "DB: %u ON: %u", (uint16)sub_no,(uint16)current_online_ctr);
	Lcd_Show_String(2, 0, text, NORMAL, 21,0x0000,0xffff);

////	// tcp port
////	sprintf(text, "PORT: %u", (uint16)MODBUSTCP_SERVER_PORT);
////	Lcd_Show_String(3, 0, text, NORMAL, 21);
//	// MAC address
////	sprintf(text, "MAC:%02X:%02X:%02X:%02X:%02X:%02X", (uint16)Modbus.mac_addr[0], (uint16)Modbus.mac_addr[1], (uint16)Modbus.mac_addr[2], (uint16)Modbus.mac_addr[3], (uint16)Modbus.mac_addr[4], (uint16)Modbus.mac_addr[5]);
////	Lcd_Show_String(3, 0, text, NORMAL, 21); 
	sprintf(text, "RX:%lu TX:%lu",ether_rx_packet,ether_tx_packet);
	Lcd_Show_String(3, 0, text, NORMAL, 21,0x0000,0xffff); 
////	get_time_text();
////	sprintf(text, "%s", time);
////	Lcd_Show_String(4, 0, text, NORMAL, 21); 
//#if USB_HOST
//	if(Modbus.usb_mode == 1)
//	{
//	 	switch(GSM_Inital_Step)
//		{
//			case IPINIT:
//			sprintf(text, "GSM INIT APN ...");
//			break;
//			case IPOPEN:
//			sprintf(text, "gsm:%u.%u.%u.%u", (uint16)GSM_remote_IP[0], (uint16)GSM_remote_IP[1], (uint16)GSM_remote_IP[2], (uint16)GSM_remote_IP[3]);
//		    break;
//			case GSM_INIT_OK:
//		    sprintf(text, "gsm intial ok");
//		    break;
//			case CMGF:
//			case CMGL:
//		    sprintf(text, "gsm check sms");
//		    break;
//			case GET_SMS_OK:
//		    sprintf(text, "gsm get ip from sms");
//		    break;
//			case RECV_DATA_FROM_T3000:
//		    sprintf(text, "gsm comm with t3000");
//		    break;
//			default:
//			break;
//				
//		}	
//		Lcd_Show_String(3, 0, text, NORMAL, 21,0xffff,0x0000);

//	}
//#endif
#if (ARM_CM5 || ASIX_CM5)
	sprintf(text, "ALARM: ");
	Lcd_Show_String(5, 0, text, NORMAL, 21,0x0000,0xffff); 
	sprintf(text, "CM5 DEMO SHOW");
	Lcd_Show_String(6, 0, text, NORMAL, 21,0x0000,0xffff); 
	sprintf(text, "www.temcocontrols.com");
	Lcd_Show_String(7, 0, text, NORMAL, 21,0x0000,0xffff); 
#endif
}


void disp_ch(uint8 form, uint16 x, uint16 y,uint8 value,uint16 dcolor,uint16 bgcolor)	
{  
	uint16 i,j;
	uint8 const *temp ;//= chlibsmall;  
  uint16 cp = 0;
	uint16 pp = 0;
	uint16 cnum;
	

	temp = chlibsmall;
	cp = 16; 
	pp = 30;
	temp += (value - 32) * 60;		

	LCD_SetPos(x,x+cp-1,y,y+pp-1);
	cnum = pp*cp/8;  
  	
	for(j = 0;j < cnum;j++)
		{
		for(i=0;i<8;i++)
			{ 		     
		 	if(((*temp >> i) & 0x01)!=0)
				{
				Write_Data(dcolor>>8,dcolor);
				} 
			else
				{
				Write_Data(bgcolor>>8,bgcolor);
				} 	
			}
		temp++;
		}
}


void Lcd_Show_String(uint16 x, uint16 y,char *str,uint8 mode,uint8 format,uint16 dcolor,uint16 bgcolor)	  
{  
	unsigned int x1,y1;
  unsigned int i,len;	
	x1 = y * 15;
	y1 = x * 30;
	len = strlen(str);
	while(*str!='\0')
	{			
		disp_ch(0,x1,y1,*str,dcolor,bgcolor);
		x1+=15;	
		str++;
	}	
	if(format > 21) format = 21;
	if(strlen(str) < format)
	{
		x1 = len * 15;
		for(i = len; i < format;i++)
		{	
			disp_ch(0,x1,y1,' ',dcolor,bgcolor);
			x1+=15;	
		}
	}
}


#endif












